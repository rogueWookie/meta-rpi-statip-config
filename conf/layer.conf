## conf/layer.conf
```bitbake
# We have a conf and classes directory, add to BBPATH
BBPATH .= ":${LAYERDIR}"

# We have recipes-* directories, add to BBFILES
BBFILES += "${LAYERDIR}/recipes-*/*/*.bb \
            ${LAYERDIR}/recipes-*/*/*.bbappend"

BBFILE_COLLECTIONS += "meta-rpi-staticip-interfaces/"
BBFILE_PATTERN_meta-rpi-staticip-interfaces/ = "^${LAYERDIR}/"
BBFILE_PRIORITY_meta-rpi-staticip-interfaces/ = "6"

LAYERDEPENDS_meta-rpi-staticip-interfaces/ = "core"
LAYERSERIES_COMPAT_meta-rpi-staticip-interfaces/ = "mickledore"
```
